## fangfengji/esp32/main/Kconfig.projbuild
```kconfig
menu "Example Configuration"

config MESH_ID
    string "Mesh ID"
        default "123456"
        help
            The maximum length is 6 bytes. Mesh network identification,
            Nodes with the same mesh ID can, communicate with each other.

config MESH_CHANNEL
    int "Mesh network channel"
    range 1 14
    default 13
    help
        Mesh network channel.
config UART_PORT_NUM
    int "UART PORT NUM"
    range 0 2
    default 1
    help
        choose uart port num.

config UART_BAUD_RATE
    int "UART BAUD RATE"
    range 0 921600
    default 115200
    help
        choose uart baud rate.

config UART_TX_IO
    int "UART TX IO"
    range 0 33
    default 5
    help
        choose uart tx IO.

config UART_RX_IO
    int "UART RX IO"
    range 0 33
    default 4
    help
        choose uart rx IO.

endmenu
```

## led_control_mconfig/main/Kconfig.projbuild
```kconfig
menu "Example Configuration"

menu "UART Configuration"

config UART_PORT_NUM
    int "UART PORT NUM"
    range 0 2
    default 1
    help
        choose uart port num.

config UART_BAUD_RATE
    int "UART BAUD RATE"
    range 0 921600
    default 115200
    help
        choose uart baud rate.

config UART_TX_IO
    int "UART TX IO"
    range 0 33
    default 5
    help
        choose uart tx IO.

config UART_RX_IO
    int "UART RX IO"
    range 0 33
    default 4
    help
        choose uart rx IO.

endmenu
menu "ota Configuration"

config DEVICE_VERSION
    string "Device version"
    default "0.0.1"
    help
        Config device version

config FIRMWARE_UPGRADE_URL
    string "Firmware upgrade url endpoint"
    default "http://192.168.0.3:8070/hello-world.bin"
    help
        URL of server which hosts the firmware image.

endmenu

menu "tcp Configuration"

config SERVER_IP
    string "Server IP address"
        default "192.168.0.1"
        help
            Server IP address.

config SERVER_PORT
    int "Server port"
        default "8070"
        help
            Server port.

endmenu

config MQTT_URL
    string "MQTT broker URL"
    default "mqtt://iot.eclipse.org"
    help
        URL of the broker to connect to

endmenu
```

## mupgrade1/main/Kconfig.projbuild
```kconfig
menu "Example Configuration"
choice DEVICE_TYPE
    bool "Configure the device type"
    default DEVICE_TYPE_NODE
    help
        Configure the device type

config DEVICE_TYPE_IDLE
   bool "IDLE device"
config DEVICE_TYPE_ROOT
   bool "Root device"
config DEVICE_TYPE_NODE
   bool "Non-Root device"
config DEVICE_TYPE_LEAF
   bool "Leaf device"
endchoice

config DEVICE_TYPE
    int
    default 0 if DEVICE_TYPE_IDLE
    default 1 if DEVICE_TYPE_ROOT
    default 2 if DEVICE_TYPE_NODE
    default 3 if DEVICE_TYPE_LEAF

config MESH_ID
    string "Mesh ID"
        default "123456"
        help
            The maximum length is 6 bytes. Mesh network identification,
            Nodes with the same mesh ID can, communicate with each other.

config MESH_CHANNEL
    int "Mesh network channel"
    range 1 14
    default 13
    help
        Mesh network channel.
config DEVICE_VERSION
    string "Device version"
    default "0.0.1"
    help
        Config device version

config ROUTER_SSID
    string "Router SSID"
        default "ROUTER_SSID"
        help
            Router SSID.

config ROUTER_PASSWORD
    string "Router password"
        default "ROUTER_PASSWORD"
        help
            Router password.


config FIRMWARE_UPGRADE_URL
    string "Firmware upgrade url endpoint"
    default "http://192.168.0.3:8070/hello-world.bin"
    help
        URL of server which hosts the firmware image.
config UART_PORT_NUM
    int "UART PORT NUM"
    range 0 2
    default 1
    help
        choose uart port num.

config UART_BAUD_RATE
    int "UART BAUD RATE"
    range 0 921600
    default 115200
    help
        choose uart baud rate.

config UART_TX_IO
    int "UART TX IO"
    range 0 33
    default 5
    help
        choose uart tx IO.

config UART_RX_IO
    int "UART RX IO"
    range 0 33
    default 4
    help
        choose uart rx IO.

endmenu
```

## mupgrade_uart/mupgrade2/main/Kconfig.projbuild
```kconfig
menu "Example Configuration"

config DEVICE_VERSION
    string "Device version"
    default "0.0.1"
    help
        Config device version

config ROUTER_SSID
    string "Router SSID"
        default "ROUTER_SSID"
        help
            Router SSID.

config ROUTER_PASSWORD
    string "Router password"
        default "ROUTER_PASSWORD"
        help
            Router password.

config MESH_ID
    string "Mesh ID"
        default "123456"
        help
            Mesh network identification, Nodes with the same mesh ID can
            communicate with each other.

config FIRMWARE_UPGRADE_URL
    string "Firmware upgrade url endpoint"
    default "http://192.168.0.3:8070/hello-world.bin"
    help
        URL of server which hosts the firmware image.
config UART_PORT_NUM
    int "UART PORT NUM"
    range 0 2
    default 1
    help
        choose uart port num.

config UART_BAUD_RATE
    int "UART BAUD RATE"
    range 0 921600
    default 115200
    help
        choose uart baud rate.

config UART_TX_IO
    int "UART TX IO"
    range 0 33
    default 5
    help
        choose uart tx IO.

config UART_RX_IO
    int "UART RX IO"
    range 0 33
    default 4
    help
        choose uart rx IO.
endmenu
```

## onOff/on_off_smconfig/main/Kconfig.projbuild
```kconfig
menu "Example Configuration"

menu "UART Configuration"

config UART_PORT_NUM
    int "UART PORT NUM"
    range 0 2
    default 1
    help
        choose uart port num.

config UART_BAUD_RATE
    int "UART BAUD RATE"
    range 0 921600
    default 115200
    help
        choose uart baud rate.

config UART_TX_IO
    int "UART TX IO"
    range 0 33
    default 5
    help
        choose uart tx IO.

config UART_RX_IO
    int "UART RX IO"
    range 0 33
    default 4
    help
        choose uart rx IO.

endmenu
menu "ota Configuration"

config DEVICE_VERSION
    string "Device version"
    default "0.0.1"
    help
        Config device version

config FIRMWARE_UPGRADE_URL
    string "Firmware upgrade url endpoint"
    default "http://192.168.0.3:8070/hello-world.bin"
    help
        URL of server which hosts the firmware image.

endmenu

menu "tcp Configuration"

config SERVER_IP
    string "Server IP address"
        default "192.168.0.1"
        help
            Server IP address.

config SERVER_PORT
    int "Server port"
        default "8070"
        help
            Server port.

endmenu


config ROUTER_SSID
    string "Router SSID"
        default "ROUTER_SSID"
        help
            Router SSID.

config ROUTER_PASSWORD
    string "Router password"
        default "ROUTER_PASSWORD"
        help
            Router password.

config MESH_ID
    string "Mesh ID"
        default "123456"
        help
            The maximum length is 6 bytes. Mesh network identification,
            Nodes with the same mesh ID can, communicate with each other.

config MESH_PASSWORD
    string "Mesh Password"
    default "MESH_PASSWORD"
    help
        Mesh AP password. Password length must be 8 bits smaller than 64 bits,Set to null to not encrypt

config MQTT_URL
    string "MQTT broker URL"
    default "mqtt://iot.eclipse.org"
    help
        URL of the broker to connect to


endmenu
```
